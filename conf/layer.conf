## conf/layer.conf
```bitbake
# We have a conf and classes directory, add to BBPATH
BBPATH .= ":${LAYERDIR}"

# We have recipes-* directories, add to BBFILES
BBFILES:append = " ${LAYERDIR}/recipes-*/*/*.bb \
            ${LAYERDIR}/recipes-*/*/*.bbappend"

BBFILE_COLLECTIONS:append = " meta-ktf"
BBFILE_PATTERN_meta-ktf = "^${LAYERDIR}/"
BBFILE_PRIORITY_meta-ktf = "6"

LAYERDEPENDS_meta-ktf = "core"
LAYERSERIES_COMPAT_meta-ktf = "kirkstone"
```
